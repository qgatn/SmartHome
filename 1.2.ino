#include <GxEPD2_BW.h> //EP
#include <Fonts/FreeMonoBold9pt7b.h> //EP
#include <Adafruit_SSD1306.h> //OLED
#include <Adafruit_GFX.h> //RFID
#include <gfxfont.h> //RFID
#include <deprecated.h> //RFID
#include <MFRC522.h> //RFID
#include <MFRC522Extended.h> //RFID
#include <require_cpp11.h> //RFID
#include <SPI.h> //RFID
#include <DS3231.h> //RTC
#include <ThingSpeak.h> //WiFi
#include <WiFiEsp.h> //WiFi
#include <stdio.h> //String
#include <string.h> //String
// --------------------------------------------------------------------------------------- Buzzer Notes and Melody
#define NOTE_B0  31
#define NOTE_C1  33
#define NOTE_CS1 35
#define NOTE_D1  37
#define NOTE_DS1 39
#define NOTE_E1  41
#define NOTE_F1  44
#define NOTE_FS1 46
#define NOTE_G1  49
#define NOTE_GS1 52
#define NOTE_A1  55
#define NOTE_AS1 58
#define NOTE_B1  62
#define NOTE_C2  65
#define NOTE_CS2 69
#define NOTE_D2  73
#define NOTE_DS2 78
#define NOTE_E2  82
#define NOTE_F2  87
#define NOTE_FS2 93
#define NOTE_G2  98
#define NOTE_GS2 104
#define NOTE_A2  110
#define NOTE_AS2 117
#define NOTE_B2  123
#define NOTE_C3  131
#define NOTE_CS3 139
#define NOTE_D3  147
#define NOTE_DS3 156
#define NOTE_E3  165
#define NOTE_F3  175
#define NOTE_FS3 185
#define NOTE_G3  196
#define NOTE_GS3 208
#define NOTE_A3  220
#define NOTE_AS3 233
#define NOTE_B3  247
#define NOTE_C4  262
#define NOTE_CS4 277
#define NOTE_D4  294
#define NOTE_DS4 311
#define NOTE_E4  330
#define NOTE_F4  349
#define NOTE_FS4 370
#define NOTE_G4  392
#define NOTE_GS4 415
#define NOTE_A4  440
#define NOTE_AS4 466
#define NOTE_B4  494
#define NOTE_C5  523
#define NOTE_CS5 554
#define NOTE_D5  587
#define NOTE_DS5 622
#define NOTE_E5  659
#define NOTE_F5  698
#define NOTE_FS5 740
#define NOTE_G5  784
#define NOTE_GS5 831
#define NOTE_A5  880
#define NOTE_AS5 932
#define NOTE_B5  988
#define NOTE_C6  1047
#define NOTE_CS6 1109
#define NOTE_D6  1175
#define NOTE_DS6 1245
#define NOTE_E6  1319
#define NOTE_F6  1397
#define NOTE_FS6 1480
#define NOTE_G6  1568
#define NOTE_GS6 1661
#define NOTE_A6  1760
#define NOTE_AS6 1865
#define NOTE_B6  1976
#define NOTE_C7  2093
#define NOTE_CS7 2217
#define NOTE_D7  2349
#define NOTE_DS7 2489
#define NOTE_E7  2637
#define NOTE_F7  2794
#define NOTE_FS7 2960
#define NOTE_G7  3136
#define NOTE_GS7 3322
#define NOTE_A7  3520
#define NOTE_AS7 3729
#define NOTE_B7  3951
#define NOTE_C8  4186
#define NOTE_CS8 4435
#define NOTE_D8  4699
#define NOTE_DS8 4978
#define REST      0
#define melodyPin 6// Pin for passive buzzer
int song_speed = 1; // change the speed of alarm song
// ---------- Mario main theme melody
int melody[] = {
  NOTE_E7, NOTE_E7, 0, NOTE_E7,  0, NOTE_C7, NOTE_E7, 0,  NOTE_G7, 0, 0,  0,  NOTE_G6, 0, 0, 0,  NOTE_C7, 0, 0, NOTE_G6,  0, 0, NOTE_E6, 0,  0, NOTE_A6, 0, NOTE_B6,  0, NOTE_AS6, NOTE_A6, 0,  NOTE_G6, NOTE_E7, NOTE_G7,  NOTE_A7, 0, NOTE_F7, NOTE_G7,
  0, NOTE_E7, 0, NOTE_C7,  NOTE_D7, NOTE_B6, 0, 0,  NOTE_C7, 0, 0, NOTE_G6,  0, 0, NOTE_E6, 0,  0, NOTE_A6, 0, NOTE_B6,  0, NOTE_AS6, NOTE_A6, 0,  NOTE_G6, NOTE_E7, NOTE_G7,  NOTE_A7, 0, NOTE_F7, NOTE_G7,  0, NOTE_E7, 0, NOTE_C7,  NOTE_D7, NOTE_B6, 0, 0,
//  Under world tone
  NOTE_C4, NOTE_C5, NOTE_A3, NOTE_A4,  NOTE_AS3, NOTE_AS4, 0,  0,  NOTE_C4, NOTE_C5, NOTE_A3, NOTE_A4,  NOTE_AS3, NOTE_AS4, 0,  0,  NOTE_F3, NOTE_F4, NOTE_D3, NOTE_D4,  NOTE_DS3, NOTE_DS4, 0,  0,  NOTE_F3, NOTE_F4, NOTE_D3, NOTE_D4,  NOTE_DS3, NOTE_DS4, 0,  0, NOTE_DS4, NOTE_CS4, NOTE_D4,
  NOTE_CS4, NOTE_DS4,  NOTE_DS4, NOTE_GS3,  NOTE_G3, NOTE_CS4,  NOTE_C4, NOTE_FS4, NOTE_F4, NOTE_E3, NOTE_AS4, NOTE_A4,  NOTE_GS4, NOTE_DS4, NOTE_B3,  NOTE_AS3, NOTE_A3, NOTE_GS3,  0, 0, 0};
//Mario main them tempo
int tempo[] = {
  12, 12, 12, 12,   12, 12, 12, 12,  12, 12, 12, 12,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 12,
  12, 12, 12, 12,  12, 12, 12, 12,  9, 9, 9,  12,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 6,
  6, 18, 18, 18,  6, 6,  6, 6,  6, 6,  18, 18, 18, 18, 18, 18,  10, 10, 10,  10, 10, 10,  3, 3, 3};
int time_left=0;
int final=0;
int noteDuration;
// --------------------------------------------------------------------------------------- OLED PNGs Bitmaps
const unsigned char bitmap_setting [] PROGMEM = {
  0x00, 0x00, 0x00, 0x00, 0x00, 0x00, 0x00, 0x7f, 0xfe, 0x00, 0x00, 0x00,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 0x00, 
  0x00, 0x00, 0x00, 0x00, 0x00, 0x00, 0x03, 0xe0, 0x07, 0xc0, 0x00, 0x00,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 0x00, 
  0x00, 0x00, 0x00, 0x00, 0x01, 0xff, 0xff, 0x80, 0x01, 0xff, 0xff, 0x80,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 0x00, 
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  0x00, 0x00, 0x00, 0x00, 0x00, 0x00, 0x03, 0xe0, 0x07, 0xc0, 0x00, 0x00,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 0x00
};
const unsigned char bitmap_upload [] PROGMEM = {
  0x00, 0x00, 0x00, 0x00, 0x00, 0x00, 0x00, 0x00, 0x00, 0x00, 0x00, 0x00,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 0x00, 
  0x00, 0x00, 0x00, 0x00, 0x00, 0x00, 0x00, 0x00, 0x00, 0x00, 0x00, 0x00,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 0x00, 
  0x00, 0x00, 0x00, 0x00, 0x00, 0x00, 0x03, 0xff, 0xff, 0xc0, 0x00, 0x00,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 0x00, 
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  0x00, 0x00, 0x00, 0x00, 0x00, 0x00, 0x00, 0x00, 0x00, 0x00, 0x00, 0x00,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 0x00
};
const unsigned char bitmap_alarm [] PROGMEM = {
  0x00, 0x00, 0x00, 0x00, 0x00, 0x00, 0x1f, 0x80, 0x00, 0x00, 0x00, 0x00,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 0x00, 
  0x00, 0x00, 0x00, 0x00, 0x00, 0x03, 0x07, 0xfc, 0x1f, 0xe0, 0x00, 0x00,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 0x00, 
  0x00, 0x00, 0x00, 0x00, 0x00, 0x00, 0x1f, 0x30, 0x0c, 0xf8, 0xe0, 0x30,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 0x00, 
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  0x00, 0x00, 0x00, 0x00, 0x00, 0x00, 0x00, 0x00, 0x06, 0x00, 0x00, 0x00,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 0x00
};
// --------------------------------------------------------------------------------------- RFID
#define SS_PIN 53
#define RST_PIN 5
MFRC522 rfid(SS_PIN, RST_PIN); // Create object Instance
MFRC522::MIFARE_Key key; //create variable “key” with MIFARE_Key structure
byte nuidPICC[4];// Init array that will store new NUID
int arr[4]={172, 212, 58, 24};
int arr2[4]={170, 200, 216, 173};
int flag = 0;
//cnt=0, cnt2=0,z=1;
int me =0;
// --------------------------------------------------------------------------------------- E-Paper
#define MAX_DISPLAY_BUFFER_SIZE 800
#define MAX_HEIGHT(EPD)(EPD::HEIGHT <= MAX_DISPLAY_BUFFER_SIZE / (EPD::WIDTH / 8) ? EPD::HEIGHT : MAX_DISPLAY_BUFFER_SIZE / (EPD::WIDTH / 8))
GxEPD2_BW<GxEPD2_154_D67, MAX_HEIGHT(GxEPD2_154_D67)> display(GxEPD2_154_D67(/*CS=10*/ 10, /*DC=*/ 9, /*RST=*/ 8, /*BUSY=*/ 7)); // GDEH0154D67 200x200
// --------------------------------------------------------------------------------------- HC05
String BT_input;
int hh[6];
int mm[6];
int h, m, r;
int count; 
// --------------------------------------------------------------------------------------- OLED
#define SCREEN_WIDTH 128
#define SCREEN_HEIGHT 64
#define OLED_RESET -1
Adafruit_SSD1306 oled(SCREEN_WIDTH, SCREEN_HEIGHT, &Wire, OLED_RESET); // oled 
// --------------------------------------------------------------------------------------- RTC
DS3231  rtc(SDA, SCL);
int cur_h, cur_m, chk_h, chk_m, alarm_h, alarm_m;
// --------------------------------------------------------------------------------------- WiFi
#define SECRET_CH_ID 1573592
#define SECRET_WRITE_APIKEY "IU9IGXF4WPN9I5SE"
#define SECRET_READ_APIKEY "NJR60WS1ULDXT9LC"
#define ESP_BAUDRATE 115200
char ssid[] = "EE3070_P1404_1";
char pass[] = "EE3070P1404";
int status = WL_IDLE_STATUS;
unsigned long myChannelNumber = SECRET_CH_ID;
const char * myWriteAPIKey = SECRET_WRITE_APIKEY;
const char * myReadAPIKey = SECRET_READ_APIKEY;
unsigned int counterFieldNumber = 1;
// --------------------------------------------------------------------------------------- String Schedule
#define NUM_STRINGS 10
#define MAX_LENGTH_OFSTRING 1000
//char plan[NUM_STRINGS][MAX_LENGTH_OFSTRING +1 /*for '\0' Null Character */];
String plan[NUM_STRINGS];
int pt1 = 0;
int pt2 = 50;
// --------------------------------------------------------------------------------------- Smart Irrigation
const int red=2,relaymotor=3;
int humlevel,counter;
float perc;
int mandelay = 0;
int req;
// --------------------------------------------------------------------------------------- flags
int schedule_input = 0;
int alarm_input = 0;
int alarm_flag = 0;
// --------------------------------------------------------------------------------------- setup() Function
void setup() 
{
  // --- Serial Monitor
  Serial.begin(9600);
  Serial.println("Serial Monitor set to 9600");
  EP_up();
  // --- HC05
  Serial1.begin(9600);
  Serial.println("Bluetooth HC05 set to 9600");
  count = 0;
  // --- OLED
  if(!oled.begin(SSD1306_SWITCHCAPVCC, 0x3C))
  {
    Serial.println(F("SSD1306 Allocation Failes"));
  }
  oled_up(100);
  Serial.println("oled_up completed");
  // --- Buzzer
  pinMode(melodyPin, OUTPUT);
  // --- E-Paper
  EP_up(); 
  // --- RFID
  SPI.begin(); // Init SPI bus
  rfid.PCD_Init(); // Init the MFRC522 chip
  for (byte i = 0; i < 6; i++) 
  {
      key.keyByte[i] = 0xFF;
  }
  // --- RTC
  rtc.begin();
  cur_h = -1;
  cur_m = -1;
  // --- WiFi 
  Serial2.begin(ESP_BAUDRATE);
  WiFi.init(&Serial2);
  if(WiFi.status() != WL_CONNECTED)
  {
    Serial.print("Attempting to connect to SSID: ");
    Serial.println(ssid);
    while(WiFi.status() != WL_CONNECTED)
    {
      WiFi.begin(ssid, pass);
      Serial.println(".");
      delay(1000);
    }  
  }
  Serial.println("WiFi Connected");
  // --- Final
  Serial.println("Initialize Completed");
  pinMode(A0,INPUT);
  pinMode(red,OUTPUT);
  pinMode(relaymotor,OUTPUT);
  mandelay = 10000;
}
// --------------------------------------------------------------------------------------- loop() Function ---------------------------------------------------------------------------------------------------------------------------------------------------- Rework!!!
void loop() 
{
  me =0;
  mandelay--;
  oled_up(4); //Display Time
  if(Serial1.available()) //Bluetooth Check
  {
    BT_read();    
  }
  if(alarm_flag == 1)
  {
    oled_up(30);
    final = 0;
    time_left = 0;
    sing();
  }
  else if(alarm_input == 1)
  {
    EP_up();      
    alarm_input = 0; 
  }   
  if(mandelay < 1)
  {
    humlevel=analogRead(A0);
    perc=abs(100-(humlevel/10.23));
    Serial.println("Curret Moisture is: ");
    Serial.println(perc);
    if(perc*100 < req)
    {
      Serial.println("Watering");
      iteration();
    }
    mandelay = 1000;
  }
}
// --------------------------------------------------------------------------------------- EP_up() Function
void EP_up()//E-Paper Base
{
  display.init();
  display.firstPage();
  do{
      display.setRotation(1);
      display.fillScreen(GxEPD_WHITE);
        // --- Schedule Planner
      display.setCursor(0,0);
      display.setTextColor(GxEPD_BLACK);
      display.setTextSize(3); // heading size 3
      display.print("Schedule");  
      display.setCursor(0,25);          
      display.print("    Planner");
      display.drawLine(0,50,200,50,GxEPD_BLACK); 
        // --- Current Alarms
      display.setCursor(0,55); // giving 5 horizontal space for clarity
      display.setTextColor(GxEPD_BLACK);
      display.setTextSize(2);
      display.print("Current Alarms: ");
      if(count == 0)
      {
        display.fillCircle(20,85-3,5,GxEPD_BLACK);
        display.setCursor(40,75); // giving 5 horizontal space for clarity
        display.setTextColor(GxEPD_BLACK);
        display.setTextSize(2);
        display.print("None");
      }
      else
      {
        for(int i =0; i< count; i++)
        {
          display.fillCircle(20,(85+(20*i))-3,5,GxEPD_BLACK);
          display.setCursor(40,75+(20*i)); // giving 5 horizontal space for clarity
          display.setTextColor(GxEPD_BLACK);
          display.setTextSize(2);
          display.print(hh[i]);
          display.print(':');
          display.print(mm[i]);
        }
      }           
    }while(display.nextPage());    
  display.powerOff();
}
// --------------------------------------------------------------------------------------- EP_alarm() Function
void EP_alarm()
{
  display.init();
  display.firstPage();
  do{
      display.setRotation(1);      
      display.setTextColor(GxEPD_BLACK);
      if(count == 0)
      {
        display.drawLine(0,65,200,65,GxEPD_BLACK);
      }         
    }while(display.nextPage());    
  display.powerOff();
}
// --------------------------------------------------------------------------------------- BT_read() Function 
void BT_read()
{
  oled_up(21);
  BT_input = Serial1.readString();
  Serial.print(BT_input);
  if(BT_input[0] == '9') // ----- Activate Alarm
  {
    alarm_flag = 1;
  }
  else if(BT_input[0] == '1') // ----- Show Schedule User 1
  {
    me = 1;
    Serial.println("Call 3");
    oled_up(32);
    me = 0;
  }  
  else if(BT_input[0] == '2') // ----- Show Schedule User 2
  {
    me = 2;
    Serial.println("Call 4");
    oled_up(32);
    me = 0;
  }
  else if(BT_input[0] == '/') // ----- Update Schedule 
  {
    if(BT_input[1] == '1')
    {
      plan[pt1] = BT_input;
      pt1++;
    }
    else if(BT_input[1] == '2')
    {
      plan[pt2] = BT_input;
      pt2++;      
    }
  }
  else if(BT_input[0] == '\\') // ---- Remove Schedule
  {
    BT_input[0] = '/';
    int r = 0;
    if(BT_input[1] == '1')
    {
      for(int i = 0; i < pt1; i++)
      {
        if(plan[i] == BT_input)
        {
          r = i;
        }
      }
      for(int i = r; i < pt1 -1 ; i++)
      {
        plan[i] = plan[i+1];
      } 
      pt1--;
    }
    else if(BT_input[1] == '2')
    {
      for(int i = 50; i < pt2; i++)
      {
        if(plan[i] == BT_input)
        {
          r = i;
        }
      }
      for(int i = r; i < pt2 -1 ; i++)
      {
        plan[i] = plan[i+1];
      }     
    }
    pt2--;
  }
  else if(BT_input[0] == '!') // ---- Irrigation System
  { // input of form !78.65 where h = 78 and m = 65
    h = ((int(BT_input[1]) - 48)*10)+ (int(BT_input[2]) - 48);
    m = ((int(BT_input[4]) - 48)*10)+ (int(BT_input[5]) - 48);
    Serial.print("Irrigation System");
    Serial.print(h);
    Serial.println(m);
    req = h*100 + m;
    Serial.print("Humidity set to: ");
    Serial.println(req);
  }
  else if(BT_input[0] == ':') // ----- Add Pet Food timing
  {
    h = ((int(BT_input[1]) - 48)*10)+ (int(BT_input[2]) - 48);
    m = ((int(BT_input[3]) - 48)*10)+ (int(BT_input[4]) - 48);
    wifi_up(h, m, 5, 3);
  }
  else if(BT_input[0] == ';') // ----- Remove Pet Food timing
  {
    h = ((int(BT_input[1]) - 48)*10)+ (int(BT_input[2]) - 48);
    m = ((int(BT_input[3]) - 48)*10)+ (int(BT_input[4]) - 48);
    wifi_up(h, m, -5, 3);
  }
  else if(BT_input[0] == '+') // ----- Add Alarm
  {
    h = ((int(BT_input[1]) - 48)*10)+ (int(BT_input[2]) - 48);
    m = ((int(BT_input[3]) - 48)*10)+ (int(BT_input[4]) - 48);
    r = int(BT_input[5]) - 48;
    Serial.print("  Time is set to (HHMM) ");
    Serial.print(h);
    Serial.print(m);
    Serial.print(" at room ");
    Serial.println(r);  
    oled_up(22);
    if(r == 2)
    {
      wifi_up(h, m, 1, 1);
    }
    else if(r == 1)
    {
      hh[count] = h;
      mm[count] = m;
      count+=1;
      alarm_input = 1;
      next_alarm();
    }    
  }
  else if(BT_input[0] == '-') // ----- Remove Alarm
  {
    h = ((int(BT_input[1]) - 48)*10)+ (int(BT_input[2]) - 48);
    m = ((int(BT_input[3]) - 48)*10)+ (int(BT_input[4]) - 48);
    r = int(BT_input[5]) - 48;
    Serial.print("  Time to remove is (HHMM) ");
    Serial.print(h);
    Serial.print(m);
    Serial.print(" at room ");
    Serial.println(r);  
    oled_up(22);
    if(r == 2)
    {
      wifi_up(h, m, -1, 1);
    }
    else if(r == 1)
    {
      for(int i =0; i< count; i++)
      {
        if((h == hh[i])&&(m == mm[i]))
        {
          for(int j = i+1; j< count; j++)
          {
            hh[j-1] = hh[j];
            mm[j-1] = mm[j];
          }
          count -=1;
          break;
        }
      }
      alarm_input = 1;
      if(count == 0)
      {
        alarm_h = 25;
      }
      else
      {
        next_alarm();
      }
    }    
  }   
}
// --------------------------------------------------------------------------------------- wifi_up() Function
void wifi_up(int hc, int mc, int s, int f)
{
  oled_up(50);
  int n = 1;
  int c;
  WiFiEspClient client;
  ThingSpeak.begin(client);
  long t = (hc*100)+mc;
  Serial.println("WiFi Uploading");
  Serial.println(t);
  while(n == 1)
  {
    ThingSpeak.setField(f, t); //alarm_time
    ThingSpeak.setField(2, s); //alarm_status
    //ThingSpeak.writeField(myChannelNumber, 1 , t, myWriteAPIKey);
    //delay(1000);
    //ThingSpeak.writeField(myChannelNumber, 2 , 1, myWriteAPIKey);
    //delay(1000);
    ThingSpeak.writeFields(myChannelNumber, myWriteAPIKey);
    delay(500);
    c = ThingSpeak.readIntField(myChannelNumber, 2, myReadAPIKey);
    if(c == s)
    {
      n = 0;
    }
  }  
  int statusCode = ThingSpeak.getLastReadStatus();
  Serial.println(statusCode);
}
// --------------------------------------------------------------------------------------- oled_up() Function
void oled_up(int a)
{
  // Used: 1, 21, 22, 30, 31, 50, 4, 100
 //Serial.println(a);
 if(a == 1)// Welcome message
 {
    oled.clearDisplay();
    oled.setCursor(0,0);
    oled.setTextColor(SSD1306_WHITE);
    oled.setTextSize(2);
    oled.println(F("Welcome,"));
    oled.setTextSize(1);
    oled.display();
 } 
 else if(a == 21)// BT receiving
 {
    oled_up(1);
    oled.setCursor(0,20);
    oled.print(F("Receiving Bluetooth data...."));
    oled.display();    
    cur_h = -1;
    cur_m = -1;
 }
 else if(a == 22)// Successfully Received
 {
    oled_up(1);
    oled.setCursor(0,20);
    oled.println(F("Data Received Successfully"));
    oled.print("Time: ");
    oled.print(hh[count-1]);
    oled.print(".");
    oled.println(mm[count-1]);
    oled.display();
    delay(1000);
 }
 else if(a == 100)// Setting
 {
    oled.clearDisplay(); //for Clearing the display
    // display.drawBitmap(x position, y position, bitmap data, bitmap width, bitmap height, color)
    oled.drawBitmap(0, 0, bitmap_setting, 128, 64, WHITE);
    oled.display();
 }
 else if(a == 30)// Alarm Started
 {
    oled.clearDisplay(); //for Clearing the display
    // display.drawBitmap(x position, y position, bitmap data, bitmap width, bitmap height, color)
    oled.drawBitmap(0, 0, bitmap_alarm, 128, 64, WHITE);
    oled.display();
 }
 else if(a == 31)// Alarm Stop
 {
    oled_up(1);
    oled.setCursor(0,20);
    oled.print(F("RFID "));
    oled.print(me);
    oled.println(" Sucessful");
    oled.println(F("Thank you :)"));
    oled.display();
    delay(1000);
    cur_h = -1;
    cur_m = -1;
 }
 else if(a == 32)// Alarm Stop
 {
    Serial.println("Entered Schedule");
    oled.clearDisplay();    
    int min, max;
    if(me == 1)
    {
      min = 0;
      max = pt1;
    }
    else
    {
      min = 50;
      max = pt2;
    }
    me = 0;
    Serial.println("Min and max are ");
    Serial.println(min);
    Serial.println(max);
    if(min == max)
    {
      return;
    }
    for(int i = min; i < max; i++)
    {
      oled.clearDisplay();
      Serial.println(plan[i]);
      oled.setCursor(0,0);
      oled.setTextSize(2);
      oled.print("User ");
      oled.println(me);
      for(int j = 2; j < plan[i].length(); j++)
      {
        oled.print(plan[i][j]);
      }
      oled.display();
      delay(2000);
    }
    cur_h = -1;
    cur_m = -1;
 }
 else if(a == 50)// Wifi Uploading
 {
    oled.clearDisplay(); //for Clearing the display
    oled.drawBitmap(0, 0, bitmap_upload, 128, 64, WHITE); // display.drawBitmap(x position, y position, bitmap data, bitmap width, bitmap height, color)
    oled.display();
    cur_h = -1;
    cur_m = -1;
 }
 else if(a == 4)// Displaying Time 
 {
    String a = rtc.getTimeStr();
    chk_h = ((int(a[0]) - 48)*10)+ (int(a[1]) - 48);
    chk_m = ((int(a[3]) - 48)*10)+ (int(a[4]) - 48);
    if(chk_m != cur_m)
    {
      cur_h = chk_h;
      cur_m = chk_m;
      oled_up(1);    
      oled.setCursor(0,20);
      oled.setTextSize(2);      
      oled.println(rtc.getDOWStr());
      oled.print(cur_h);
      oled.print(":");
      oled.println(cur_m);
      oled.setTextSize(1);
      oled.println(rtc.getDateStr());      
      oled.display();
    }
    if((chk_h == alarm_h)&&(alarm_m == chk_m))
    {
      alarm_flag = 1;
      next_alarm();
    }    
 }
}
// --------------------------------------------------------------------------------------- next_alarm() Function
void next_alarm()
{
  int diff, temp, cur, d, set;
  diff = 2400;
  cur = (cur_h * 100)+cur_m;
  for(int i = 0; i< count; i++)
  {
    temp = (hh[i]*100) + mm[i];
    d = temp - cur;
    if(d< 0)
    {
      d+= 2400 - cur;
    }
    if((d< diff)&&(d>0))
    {
      diff = d;
      set = temp;
    }
  }
  alarm_h = set/100;
  alarm_m = set%100;
  Serial.print("Next Alarm: ");
  Serial.print(alarm_h);
  Serial.print(":");
  Serial.println(alarm_m);  
  Serial.print("in T-mins ");
  Serial.println(diff);
}
// --------------------------------------------------------------------------------------- RF() Function
void RF()
{    
  //Serial.print(F("PICC type: "));
  MFRC522::PICC_Type piccType = rfid.PICC_GetType(rfid.uid.sak);
  //Serial.println(rfid.PICC_GetTypeName(piccType));
  // Check whether the card type is Classic MIFARE type or not
  if(piccType != MFRC522::PICC_TYPE_MIFARE_MINI &&
  piccType != MFRC522::PICC_TYPE_MIFARE_1K &&
  piccType != MFRC522::PICC_TYPE_MIFARE_4K) 
  {    
     //Serial.println(F("Your tag is not of type MIFARE Classic."));
     return;
  }
  // check whether the UID of the card is the same as the stored one
  for (byte i = 0; i < 4; i++) 
  {
    //says if RFID is tapped or not
     nuidPICC[i] = rfid.uid.uidByte[i];
     flag=0;
     for(int k = 0; k < 4; k++)
     {
        if(arr[k]==rfid.uid.uidByte[i])
        {
           me = 1;
           flag = 1;
        }
       else if(arr2[k]==rfid.uid.uidByte[i])
       {
           me = 2;
           flag = 2;
       }
       else
       {
           //Serial.println("Wrong RFID has been tapped");
       }
     }
  }
  rfid.PICC_HaltA();
  rfid.PCD_StopCrypto1();
}
// --------------------------------------------------------------------------------------- sing() Function
void sing()
{
  int size = sizeof(melody) / sizeof(int);
  for (int thisNote = 0; thisNote < size && me == 0; thisNote++)
  {    
    //RFID reading between every note for accuracy
    if(rfid.PICC_IsNewCardPresent()) // Check whether there is PICC card
    {
      if(rfid.PICC_ReadCardSerial())
      {
        RF(); //reads RFID 
      }
    }
    if(me != 0)// returns control if RFID is tapped
    {
      oled_up(32);
      alarm_flag = 0;
      me = 0;
      flag = 0;
      return;
    }
    else
    {
      noteDuration = 1000 / (tempo[thisNote]*song_speed);
      buzz(melodyPin, melody[thisNote], noteDuration);
      // to distinguish the notes, set a minimum time between them.
      // the note's duration + 30% seems to work well:
      int pauseBetweenNotes = noteDuration * 1.30;
      delay(pauseBetweenNotes);
      // stop the tone playing:
      buzz(melodyPin, 0, noteDuration);
    }    
  }
}
// --------------------------------------------------------------------------------------- buzz() Function
void buzz(int targetPin, long frequency, long length) 
{
  long delayValue = 1000000 / frequency / 2;
  long numCycles = frequency * length / 1000;
  for (long i = 0; i < numCycles; i++) 
  { // for the calculated length of time...
    digitalWrite(targetPin, HIGH); // write the buzzer pin high to push out the diaphram
    delayMicroseconds(delayValue); // wait for the calculated delay value
    digitalWrite(targetPin, LOW); // write the buzzer pin low to pull back the diaphram
    delayMicroseconds(delayValue); // wait again or the calculated delay value
  }

}
// --------------------------------------------------------------------------------------- iteration() Function
void iteration()
{
  digitalWrite(red,HIGH);
  digitalWrite(relaymotor,HIGH);
  delay(200);
  digitalWrite(relaymotor,LOW);
}
