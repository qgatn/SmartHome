#include <Adafruit_SSD1306.h> //OLED
#include <DS3231.h> //RTC
#include <ThingSpeak.h> //WiFi
#include <WiFiEsp.h> //WiFi
#include <Servo.h> //Servo Motor
// --------------------------------------------------------------------------------------- OLED PNGs Bitmaps
const unsigned char bitmap_setting [] PROGMEM = {
  0x00, 0x00, 0x00, 0x00, 0x00, 0x00, 0x00, 0x7f, 0xfe, 0x00, 0x00, 0x00,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 0x00, 
  0x00, 0x00, 0x00, 0x00, 0x00, 0x00, 0x03, 0xe0, 0x07, 0xc0, 0x00, 0x00,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 0x00, 
  0x00, 0x00, 0x00, 0x00, 0x01, 0xff, 0xff, 0x80, 0x01, 0xff, 0xff, 0x80,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 0x00, 
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  0x00, 0x00, 0x00, 0x00, 0x00, 0x00, 0x03, 0xe0, 0x07, 0xc0, 0x00, 0x00,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 0x00
};
const unsigned char bitmap_alarm [] PROGMEM = {
  0x00, 0x00, 0x00, 0x00, 0x00, 0x00, 0x1f, 0x80, 0x00, 0x00, 0x00, 0x00,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 0x00, 
  0x00, 0x00, 0x00, 0x00, 0x00, 0x03, 0x07, 0xfc, 0x1f, 0xe0, 0x00, 0x00,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 0x00, 
  0x00, 0x00, 0x00, 0x00, 0x00, 0x00, 0x1f, 0x30, 0x0c, 0xf8, 0xe0, 0x30,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 0x00, 
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  0x00, 0x00, 0x00, 0x00, 0x00, 0x00, 0x00, 0x00, 0x06, 0x00, 0x00, 0x00,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 0x00
};
const unsigned char bitmap_donwloading [] PROGMEM = {
  0x00, 0x00, 0x00, 0x00, 0x00, 0x00, 0x00, 0x00, 0x00, 0x00, 0x00, 0x00,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 0x00, 
  0x00, 0x00, 0x00, 0x00, 0x00, 0x00, 0x7f, 0x00, 0x00, 0x7e, 0x00, 0x00,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 0x00, 
  0x00, 0x00, 0x00, 0x00, 0x00, 0x07, 0x80, 0x00, 0x00, 0x01, 0xe0, 0x00,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 0x00, 
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  0x00, 0x00, 0x00, 0x00, 0x00, 0x00, 0x00, 0x00, 0x00, 0x00, 0x00, 0x00, 0x00, 0x00, 0x00, 0x00
};
// --------------------------------------------------------------------------------------- OLED
#define SCREEN_WIDTH 128
#define SCREEN_HEIGHT 64
#define OLED_RESET -1
Adafruit_SSD1306 oled(SCREEN_WIDTH, SCREEN_HEIGHT, &Wire, OLED_RESET); // oled 
// --------------------------------------------------------------------------------------- RTC
DS3231  rtc(SDA, SCL);
int cur_h, cur_m, chk_h, chk_m, alarm_h, alarm_m;
// --------------------------------------------------------------------------------------- Servo motor
Servo servo;
int numoftrns = 2;
// --------------------------------------------------------------------------------------- WiFi
#define SECRET_CH_ID 1573592
#define SECRET_WRITE_APIKEY "IU9IGXF4WPN9I5SE"
#define SECRET_READ_APIKEY "NJR60WS1ULDXT9LC"
#define ESP_BAUDRATE 115200
char ssid[] = "EE3070_P1404_1";
char pass[] = "EE3070P1404";
int status = WL_IDLE_STATUS;
unsigned long myChannelNumber = SECRET_CH_ID;
const char * myWriteAPIKey = SECRET_WRITE_APIKEY;
const char * myReadAPIKey = SECRET_READ_APIKEY;
unsigned int counterFieldNumber = 1;
int alarm_flag, acount, pcount, c, tempread, f;
int phhmm[10];
int ahhmm[10];
// --------------------------------------------------------------------------------------- setup() Function
void setup() 
{
  pinMode(5,OUTPUT);
  // --- Serial Monitor
  Serial.begin(9600);
  Serial.println("Serial Monitor set to 9600");
  // --- OLED
  if(!oled.begin(SSD1306_SWITCHCAPVCC, 0x3C))
  {
    Serial.println(F("SSD1306 Allocation Failes"));
  }
  Serial.println("oled_up completed"); 
  oled.clearDisplay();
  oled.display();
  oled_up(100);
  // --- RTC
  rtc.begin();
  cur_h = -1;
  cur_m = -1;
  Serial2.begin(ESP_BAUDRATE);
  WiFi.init(&Serial2);
  if(WiFi.status() != WL_CONNECTED)
  {
    Serial.print("Attempting to connect to SSID: ");
    Serial.println(ssid);
    while(WiFi.status() != WL_CONNECTED)
    {
      WiFi.begin(ssid, pass);
      Serial.println(".");
      delay(1000);
    }  
  }
  Serial.println("WiFi Connected");
  // --- Final
  Serial.println("Initialize Completed");
  Serial.println(rtc.getDOWStr());
  Serial.println(rtc.getDateStr());
  acount = 0;  
  pcount = 0;  
  servo.attach(8);
}
// --------------------------------------------------------------------------------------- loop() Function
void loop()
{
  oled_up(4);  
  WiFiEspClient client;
  ThingSpeak.begin(client);
  c = ThingSpeak.readIntField(myChannelNumber, 2, myReadAPIKey);
  Serial.print("Status is: ");
  Serial.println(c);
  if(c != 0)
  {
    oled_up(128);
    wifi_down();
  }
}
// --------------------------------------------------------------------------------------- wifi_down() Function
void wifi_down()
{
  f = 0;
  if((c == 1)||(c == -1))
  {
    f = 1;
    Serial.println("Alarm Editing");
  }
  else if((c == -5)||(c == 5))
  {
    f = 3;
    Serial.println("Pet Food Editing");
  }
  else if(c == 4)
  {
    f = 4;
  }
  tempread = ThingSpeak.readLongField(myChannelNumber, f, myReadAPIKey);
  delay(500);
  ThingSpeak.writeField(myChannelNumber, 2 , 0, myWriteAPIKey);
  delay(200);
  Serial.print("Download is: ");
  Serial.println(tempread);
  if(c == 1) //Add Alarm
  {
    ahhmm[acount] = tempread;
    acount++;
  }
  else if(c == -1)//Remove Alarm
  {
    int pos = -1;
    for(int i = 0 ; i< acount; i++)
    {
      if(ahhmm[i] == tempread)
      {
        pos = i;
        break;
      }
    }
    if(pos != -1)
    {
      for(int i = pos; i< acount - 1;i++)
      {
        ahhmm[i] = ahhmm[i+1];
      }
      acount--;
    }
  }
  else if(c == 5)//Add pet food
  {
    phhmm[pcount] = tempread;
    pcount++;
  }
  else if(c == -5)//Remove Pet food
  {
    int pos = -1;
    for(int i = 0 ; i< pcount; i++)
    {
      if(phhmm[i] == tempread)
      {
        pos = i;
        break;
      }
    }
    if(pos != -1)
    {
      for(int i = pos; i< pcount - 1;i++)
      {
        phhmm[i] = phhmm[i+1];
      }
      pcount--;
    }    
  }
  Serial.println("Download Completed");
  cur_h = -1;
  cur_m = -1;
}
// --------------------------------------------------------------------------------------- iteration() Function
void iteration()
{
  for(int i =0; i < numoftrns; i++)
  {
    servo.write(90);
    delay(1500);
    servo.write(0);
    delay(500);  
  }  
  buzz(5,523,1000);
  
}
// --------------------------------------------------------------------------------------- oled_up() Function
void oled_up(int a)
{
  // Used: 1, 21, 22, 30, 31, 50, 4, 100
 //Serial.println(a);
 if(a == 1)// Welcome message
 {
    oled.clearDisplay();
    oled.setCursor(0,0);
    oled.setTextColor(SSD1306_WHITE);
    oled.setTextSize(2);
    oled.println(F("Welcome,"));
    oled.setTextSize(1);
    oled.display();
 }
 else if(a == 100)// Setting
 {
    oled.clearDisplay(); //for Clearing the display
    // display.drawBitmap(x position, y position, bitmap data, bitmap width, bitmap height, color)
    oled.drawBitmap(0, 0, bitmap_setting, 128, 64, WHITE);
    oled.display();
 }
 else if(a == 4)// Displaying Time 
 {
    //Serial.println(" a = 4");
    String a = rtc.getTimeStr();
    chk_h = ((int(a[0]) - 48)*10)+ (int(a[1]) - 48);
    chk_m = ((int(a[3]) - 48)*10)+ (int(a[4]) - 48);
    //Serial.println(" a = 4.1");
    if(chk_m != cur_m)
    {
      //Serial.println(" a = 4.1.1");
      cur_h = chk_h;
      cur_m = chk_m;
      oled_up(1);    
      oled.setCursor(0,20);
      oled.setTextSize(2);      
      oled.println(rtc.getDOWStr());
      oled.print(cur_h);
      oled.print(":");
      oled.println(cur_m);
      oled.setTextSize(1);
      oled.println(rtc.getDateStr());      
      oled.display();
      //Serial.println(" a = 4.1.1");
      for(int i = 0; i< pcount; i++)
      {
        if(phhmm[i] == ((cur_h*100)+cur_m))
        {
          Serial.println("Feeding");
          iteration();
          break;
        }
      } 
    }
    //Serial.println(" a = 4.2");
    
    //Serial.println(" a = 4.3");
 }
 else if(a == 128)// Downloading
 {
    oled.clearDisplay(); //for Clearing the display
    // display.drawBitmap(x position, y position, bitmap data, bitmap width, bitmap height, color)
    oled.drawBitmap(0, 0, bitmap_donwloading, 128, 64, WHITE);
    oled.display();
 }
}
void buzz(int targetPin, long frequency, long length) 
{
  long delayValue = 1000000 / frequency / 2;
  long numCycles = frequency * length / 1000;
  for (long i = 0; i < numCycles; i++) 
  { // for the calculated length of time...
    digitalWrite(targetPin, HIGH); // write the buzzer pin high to push out the diaphram
    delayMicroseconds(delayValue); // wait for the calculated delay value
    digitalWrite(targetPin, LOW); // write the buzzer pin low to pull back the diaphram
    delayMicroseconds(delayValue); // wait again or the calculated delay value
  }

}
